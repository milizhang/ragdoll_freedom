#include "ragdoll.dtsi" // Notice that the main dtsi files are included in the overlay.

&default_transform { // The matrix transform for this board is 6 columns over because the left half is 6 columns wide according to the matrix.
    col-offset = <8>;
};

&kscan0 {
    col-gpios
        = <&gpio1 11 (GPIO_ACTIVE_HIGH)>
        , <&gpio1 6 (GPIO_ACTIVE_HIGH)>
        , <&gpio1 4 (GPIO_ACTIVE_HIGH)>
        , <&gpio1 7 (GPIO_ACTIVE_HIGH)>
        , <&gpio1 2 (GPIO_ACTIVE_HIGH)>
        , <&gpio1 1 (GPIO_ACTIVE_HIGH)>
        , <&gpio0 11 (GPIO_ACTIVE_HIGH)>
        , <&gpio1 0 (GPIO_ACTIVE_HIGH)>
	;
};